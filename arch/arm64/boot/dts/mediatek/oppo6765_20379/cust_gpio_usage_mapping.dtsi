/*
 * Generated by MTK SP DrvGen Version: 3.5.160809 for MT6765.
 * 2026-08-02 08:23:36
 * Do Not Modify The File.
 * Copyright Mediatek Inc. (c) 2016.
*/

&gpio_usage_mapping {
	GPIO_FDD_BAND_SUPPORT_DETECT_2ND_PIN = <&pio 9 0>;
	GPIO_FDD_BAND_SUPPORT_DETECT_4TH_PIN = <&pio 11 0>;
	GPIO_SIM2_SIO = <&pio 35 0>;
	GPIO_SIM2_SRST = <&pio 36 0>;
	GPIO_SIM2_SCLK = <&pio 37 0>;
	GPIO_SIM1_SCLK = <&pio 38 0>;
	GPIO_SIM1_SRST = <&pio 39 0>;
	GPIO_SIM1_SIO = <&pio 40 0>;
	GPIO_SIM2_HOT_PLUG = <&pio 46 0>;
	GPIO_SIM1_HOT_PLUG = <&pio 47 0>;
	GPIO_FDD_BAND_SUPPORT_DETECT_3RD_PIN = <&pio 170 0>;
	GPIO_FDD_BAND_SUPPORT_DETECT_1ST_PIN = <&pio 171 0>;
};
